## arch/arm/mach-m2s/Kconfig
```kconfig
if ARCH_M2S

config TARGET_CORMORANT
	bool "Cormorant Autopilot"

source "board/cormorant/Kconfig"

endif
```

## board/cormorant/Kconfig
```kconfig
if TARGET_CORMORANT

config SYS_BOARD
	default "cormorant"

config SYS_CONFIG_NAME
	default "cormorant"

endif
```

## configs/cormorant_defconfig
```kconfig
CONFIG_ARM=y
CONFIG_SYS_ARCH_TIMER=y
CONFIG_ARCH_M2S=y
CONFIG_SYS_TEXT_BASE=0x00000000
CONFIG_TARGET_CORMORANT=y
CONFIG_SYS_CONSOLE_INFO_QUIET=y
CONFIG_BOARD_EARLY_INIT_F=y
CONFIG_HUSH_PARSER=y
CONFIG_SYS_PROMPT="cormorant>"
CONFIG_CMD_MEMTEST=y
CONFIG_OF_CONTROL=y
CONFIG_OF_EMBED=y
CONFIG_DEFAULT_DEVICE_TREE="cormorant"
# CONFIG_NET is not set
CONFIG_DM=y
# CONFIG_DM_DEVICE_REMOVE is not set
CONFIG_DMA=y
# CONFIG_MMC is not set
CONFIG_DM_MMC=y
CONFIG_DM_SPI_FLASH=y
CONFIG_SF_DEFAULT_SPEED=10000000
CONFIG_DM_SERIAL=y
CONFIG_SYS_NS16550=y
CONFIG_SPI=y
CONFIG_DM_SPI=y
CONFIG_SPI_MEM=y
CONFIG_M2S_SPI=y
CONFIG_FS_FAT=y
# CONFIG_HEXDUMP is not set
```
